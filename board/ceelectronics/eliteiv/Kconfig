## board/ceelectronics/eliteiv/Kconfig
```kconfig
if TARGET_ELITEIV

config SYS_BOARD
	default "eliteiv"

config SYS_VENDOR
	default "ceelectronics"

config SYS_CONFIG_NAME
	default "eliteiv"

endif
```
